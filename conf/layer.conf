## conf/layer.conf
```bitbake
# We have a conf and classes directory, add to BBPATH
BBPATH .= ":${LAYERDIR}"

# We have recipes-* directories, add to BBFILES
BBFILES += "${LAYERDIR}/recipes-*/*/*.bb \
            ${LAYERDIR}/recipes-*/*/*.bbappend"

BBFILE_COLLECTIONS += "vencoca"
BBFILE_PATTERN_vencoca = "^${LAYERDIR}/"
BBFILE_PRIORITY_vencoca = "10"
LAYERVERSION_vencoca = "1"
LAYERDEPENDS_meta-splash = "core"
LAYERSERIES_COMPAT_vencoca = "kirkstone"
```

## meta-l4s-fs/conf/layer.conf
```bitbake
# We have a conf and classes directory, add to BBPATH
BBPATH .= ":${LAYERDIR}"

# We have recipes-* directories, add to BBFILES
BBFILES += "${LAYERDIR}/recipes-*/*/*.bb \
            ${LAYERDIR}/recipes-*/*/*.bbappend"

BBFILE_COLLECTIONS += "l4s-fs"
BBFILE_PATTERN_vencoca = "^${LAYERDIR}/"
BBFILE_PRIORITY_vencoca = "10"
LAYERVERSION_vencoca = "1"
LAYERSERIES_COMPAT_vencoca = "kirkstone"
```

## meta-l4s-fs/recipes-images/btrfs/l4s-btrfs.wks
```
# short-description: Create btrfs-partition
# long-description: Create btrfs-partition for data, root fs with ext4 and boot partition with type vfat


part /boot --source bootimg-partition --ondisk mmcblk0 --fstype=vfat --label boot --active --align 4096 --size 20
part / --source rootfs --ondisk mmcblk0 --fstype=ext4 --label root --align 4096
part /btrfs --size 512 --ondisk mmcblk0 --fstype=btrfs --label data --align 1024
```

## meta-l4s-measure/conf/layer.conf
```bitbake
# We have a conf and classes directory, add to BBPATH
BBPATH .= ":${LAYERDIR}"

# We have recipes-* directories, add to BBFILES
BBFILES += "${LAYERDIR}/recipes-*/*/*.bb \
            ${LAYERDIR}/recipes-*/*/*.bbappend"

BBFILE_COLLECTIONS += "l4s-measure"
BBFILE_PATTERN_vencoca = "^${LAYERDIR}/"
BBFILE_PRIORITY_vencoca = "10"
LAYERVERSION_vencoca = "1"
LAYERSERIES_COMPAT_vencoca = "kirkstone"
```

## wic/core-image-base-btrfs.wks
```
# short-description: Create btrfs-partition
# long-description: Create btrfs-partition for data


part /boot --source bootimg-partition --ondisk mmcblk0 --fstype=vfat --label boot --active --align 4096 --size 20
part / --source rootfs --ondisk mmcblk0 --fstype=ext4 --label root --align 4096
part /btrfs --size 512 --ondisk mmcblk0 --fstype=btrfs --label data --align 1024
```

## wic/old.wks
```
# short-description: Create btrfs-partition
# long-description: Create btrfs-partition for data

# part /boot --source bootimg-pcbios --ondisk sda --label boot --active --align 1024
# part / --source rootfs --use-uuid --fstype=ext4 --label platform --align 1024

part /boot --source bootimg-partition --ondisk mmcblk0 --fstype=vfat --label boot --active --align 4096 --size 20
part / --source rootfs --ondisk mmcblk0 --fstype=ext4 --label root --align 4096
part /btrfs --size 512 --fstype=btrfs --label data --align 1024
# bootloader  --timeout=0  --append="rw oprofile.timer=1 rootfstype=ext4 "
```
